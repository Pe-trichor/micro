## build/Kconfig/Kconfig.shield
```kconfig
osource "/Users/zhangjiaqi/ncs/v2.7.0/boards/shields/*/Kconfig.shield"
osource "/Users/zhangjiaqi/ncs/v2.7.0/nrf/boards/shields/*/Kconfig.shield"
```

## build/Kconfig/Kconfig.shield.defconfig
```kconfig
osource "/Users/zhangjiaqi/ncs/v2.7.0/boards/shields/*/Kconfig.defconfig"
osource "/Users/zhangjiaqi/ncs/v2.7.0/nrf/boards/shields/*/Kconfig.defconfig"
```

## build/Kconfig/arch/Kconfig
```kconfig
# Load arch Kconfig descriptions.
osource "/Users/zhangjiaqi/ncs/v2.7.0/zephyr/arch/x86/Kconfig"
osource "/Users/zhangjiaqi/ncs/v2.7.0/zephyr/arch/xtensa/Kconfig"
osource "/Users/zhangjiaqi/ncs/v2.7.0/zephyr/arch/sparc/Kconfig"
osource "/Users/zhangjiaqi/ncs/v2.7.0/zephyr/arch/riscv/Kconfig"
osource "/Users/zhangjiaqi/ncs/v2.7.0/zephyr/arch/posix/Kconfig"
osource "/Users/zhangjiaqi/ncs/v2.7.0/zephyr/arch/nios2/Kconfig"
osource "/Users/zhangjiaqi/ncs/v2.7.0/zephyr/arch/mips/Kconfig"
osource "/Users/zhangjiaqi/ncs/v2.7.0/zephyr/arch/arm64/Kconfig"
osource "/Users/zhangjiaqi/ncs/v2.7.0/zephyr/arch/arm/Kconfig"
osource "/Users/zhangjiaqi/ncs/v2.7.0/zephyr/arch/arc/Kconfig"
```

## build/Kconfig/soc/Kconfig
```kconfig
# Load Zephyr SoC Kconfig descriptions.
osource "/Users/zhangjiaqi/ncs/v2.7.0/zephyr/soc/xlnx/zynqmp/Kconfig"
osource "/Users/zhangjiaqi/ncs/v2.7.0/zephyr/soc/xlnx/zynq7000/Kconfig"
osource "/Users/zhangjiaqi/ncs/v2.7.0/zephyr/soc/xen/Kconfig"
osource "/Users/zhangjiaqi/ncs/v2.7.0/zephyr/soc/ti/simplelink/Kconfig"
osource "/Users/zhangjiaqi/ncs/v2.7.0/zephyr/soc/ti/lm3s6965/Kconfig"
osource "/Users/zhangjiaqi/ncs/v2.7.0/zephyr/soc/ti/k3/Kconfig"
osource "/Users/zhangjiaqi/ncs/v2.7.0/zephyr/soc/telink/tlsr/Kconfig"
osource "/Users/zhangjiaqi/ncs/v2.7.0/zephyr/soc/starfive/jh71xx/Kconfig"
osource "/Users/zhangjiaqi/ncs/v2.7.0/zephyr/soc/st/stm32/Kconfig"
osource "/Users/zhangjiaqi/ncs/v2.7.0/zephyr/soc/snps/qemu_arc/Kconfig"
osource "/Users/zhangjiaqi/ncs/v2.7.0/zephyr/soc/snps/nsim/Kconfig"
osource "/Users/zhangjiaqi/ncs/v2.7.0/zephyr/soc/snps/hsdk4xd/Kconfig"
osource "/Users/zhangjiaqi/ncs/v2.7.0/zephyr/soc/snps/hsdk/Kconfig"
osource "/Users/zhangjiaqi/ncs/v2.7.0/zephyr/soc/snps/emsk/Kconfig"
osource "/Users/zhangjiaqi/ncs/v2.7.0/zephyr/soc/snps/emsdp/Kconfig"
osource "/Users/zhangjiaqi/ncs/v2.7.0/zephyr/soc/snps/arc_iot/Kconfig"
osource "/Users/zhangjiaqi/ncs/v2.7.0/zephyr/soc/silabs/Kconfig"
osource "/Users/zhangjiaqi/ncs/v2.7.0/zephyr/soc/sifive/sifive_freedom/Kconfig"
osource "/Users/zhangjiaqi/ncs/v2.7.0/zephyr/soc/rockchip/Kconfig"
osource "/Users/zhangjiaqi/ncs/v2.7.0/zephyr/soc/renode/riscv_virtual/Kconfig"
osource "/Users/zhangjiaqi/ncs/v2.7.0/zephyr/soc/renesas/smartbond/Kconfig"
osource "/Users/zhangjiaqi/ncs/v2.7.0/zephyr/soc/renesas/rzt2m/Kconfig"
osource "/Users/zhangjiaqi/ncs/v2.7.0/zephyr/soc/renesas/rcar/Kconfig"
osource "/Users/zhangjiaqi/ncs/v2.7.0/zephyr/soc/renesas/ra/Kconfig"
osource "/Users/zhangjiaqi/ncs/v2.7.0/zephyr/soc/raspberrypi/Kconfig"
osource "/Users/zhangjiaqi/ncs/v2.7.0/zephyr/soc/quicklogic/eos_s3/Kconfig"
osource "/Users/zhangjiaqi/ncs/v2.7.0/zephyr/soc/qemu/virt_riscv/Kconfig"
osource "/Users/zhangjiaqi/ncs/v2.7.0/zephyr/soc/qemu/malta/Kconfig"
osource "/Users/zhangjiaqi/ncs/v2.7.0/zephyr/soc/openisa/rv32m1/Kconfig"
osource "/Users/zhangjiaqi/ncs/v2.7.0/zephyr/soc/nxp/s32/Kconfig"
osource "/Users/zhangjiaqi/ncs/v2.7.0/zephyr/soc/nxp/rw/Kconfig"
osource "/Users/zhangjiaqi/ncs/v2.7.0/zephyr/soc/nxp/mcx/Kconfig"
osource "/Users/zhangjiaqi/ncs/v2.7.0/zephyr/soc/nxp/lpc/Kconfig"
osource "/Users/zhangjiaqi/ncs/v2.7.0/zephyr/soc/nxp/layerscape/Kconfig"
osource "/Users/zhangjiaqi/ncs/v2.7.0/zephyr/soc/nxp/kinetis/Kconfig"
osource "/Users/zhangjiaqi/ncs/v2.7.0/zephyr/soc/nxp/imxrt/Kconfig"
osource "/Users/zhangjiaqi/ncs/v2.7.0/zephyr/soc/nxp/imx/Kconfig"
osource "/Users/zhangjiaqi/ncs/v2.7.0/zephyr/soc/nuvoton/numicro/Kconfig"
osource "/Users/zhangjiaqi/ncs/v2.7.0/zephyr/soc/nuvoton/numaker/Kconfig"
osource "/Users/zhangjiaqi/ncs/v2.7.0/zephyr/soc/nuvoton/npcx/Kconfig"
osource "/Users/zhangjiaqi/ncs/v2.7.0/zephyr/soc/nordic/Kconfig"
osource "/Users/zhangjiaqi/ncs/v2.7.0/zephyr/soc/neorv32/Kconfig"
osource "/Users/zhangjiaqi/ncs/v2.7.0/zephyr/soc/native/inf_clock/Kconfig"
osource "/Users/zhangjiaqi/ncs/v2.7.0/zephyr/soc/microchip/miv/Kconfig"
osource "/Users/zhangjiaqi/ncs/v2.7.0/zephyr/soc/microchip/mec/Kconfig"
osource "/Users/zhangjiaqi/ncs/v2.7.0/zephyr/soc/lowrisc/opentitan/Kconfig"
osource "/Users/zhangjiaqi/ncs/v2.7.0/zephyr/soc/litex/litex_vexriscv/Kconfig"
osource "/Users/zhangjiaqi/ncs/v2.7.0/zephyr/soc/ite/ec/Kconfig"
osource "/Users/zhangjiaqi/ncs/v2.7.0/zephyr/soc/intel/raptor_lake/Kconfig"
osource "/Users/zhangjiaqi/ncs/v2.7.0/zephyr/soc/intel/lakemont/Kconfig"
osource "/Users/zhangjiaqi/ncs/v2.7.0/zephyr/soc/intel/intel_socfpga_std/Kconfig"
osource "/Users/zhangjiaqi/ncs/v2.7.0/zephyr/soc/intel/intel_socfpga/Kconfig"
osource "/Users/zhangjiaqi/ncs/v2.7.0/zephyr/soc/intel/intel_niosv/Kconfig"
osource "/Users/zhangjiaqi/ncs/v2.7.0/zephyr/soc/intel/intel_ish/Kconfig"
osource "/Users/zhangjiaqi/ncs/v2.7.0/zephyr/soc/intel/intel_adsp/Kconfig"
osource "/Users/zhangjiaqi/ncs/v2.7.0/zephyr/soc/intel/elkhart_lake/Kconfig"
osource "/Users/zhangjiaqi/ncs/v2.7.0/zephyr/soc/intel/atom/Kconfig"
osource "/Users/zhangjiaqi/ncs/v2.7.0/zephyr/soc/intel/apollo_lake/Kconfig"
osource "/Users/zhangjiaqi/ncs/v2.7.0/zephyr/soc/intel/alder_lake/Kconfig"
osource "/Users/zhangjiaqi/ncs/v2.7.0/zephyr/soc/infineon/cat3/Kconfig"
osource "/Users/zhangjiaqi/ncs/v2.7.0/zephyr/soc/infineon/cat1a/Kconfig"
osource "/Users/zhangjiaqi/ncs/v2.7.0/zephyr/soc/gd/gd32/Kconfig"
osource "/Users/zhangjiaqi/ncs/v2.7.0/zephyr/soc/gaisler/leon3/Kconfig"
osource "/Users/zhangjiaqi/ncs/v2.7.0/zephyr/soc/gaisler/gr716a/Kconfig"
osource "/Users/zhangjiaqi/ncs/v2.7.0/zephyr/soc/espressif/Kconfig"
osource "/Users/zhangjiaqi/ncs/v2.7.0/zephyr/soc/ene/kb1200/Kconfig"
osource "/Users/zhangjiaqi/ncs/v2.7.0/zephyr/soc/efinix/sapphire/Kconfig"
osource "/Users/zhangjiaqi/ncs/v2.7.0/zephyr/soc/cdns/xtensa_sample_controller/Kconfig"
osource "/Users/zhangjiaqi/ncs/v2.7.0/zephyr/soc/cdns/dc233c/Kconfig"
osource "/Users/zhangjiaqi/ncs/v2.7.0/zephyr/soc/brcm/bcmvk/Kconfig"
osource "/Users/zhangjiaqi/ncs/v2.7.0/zephyr/soc/brcm/bcm2712/Kconfig"
osource "/Users/zhangjiaqi/ncs/v2.7.0/zephyr/soc/brcm/bcm2711/Kconfig"
osource "/Users/zhangjiaqi/ncs/v2.7.0/zephyr/soc/atmel/sam0/Kconfig"
osource "/Users/zhangjiaqi/ncs/v2.7.0/zephyr/soc/atmel/sam/Kconfig"
osource "/Users/zhangjiaqi/ncs/v2.7.0/zephyr/soc/aspeed/Kconfig"
osource "/Users/zhangjiaqi/ncs/v2.7.0/zephyr/soc/arm/Kconfig"
osource "/Users/zhangjiaqi/ncs/v2.7.0/zephyr/soc/arm/beetle/Kconfig"
osource "/Users/zhangjiaqi/ncs/v2.7.0/zephyr/soc/andestech/Kconfig"
osource "/Users/zhangjiaqi/ncs/v2.7.0/zephyr/soc/ambiq/Kconfig"
osource "/Users/zhangjiaqi/ncs/v2.7.0/zephyr/soc/altr/zephyr_nios2f/Kconfig"
osource "/Users/zhangjiaqi/ncs/v2.7.0/zephyr/soc/altr/qemu_nios2/Kconfig"
```
